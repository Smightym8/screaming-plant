## main/Kconfig.projbuild
```kconfig
menu "Screaming Plant: Soil moisture sensor"

    config SOIL_MOISTURE_DRY_MV
        int "Sensor voltage when dry (mV)"
        range 0 3300
        default 2400
        help
            Sensor output voltage with the probe in dry air. Read the value from
            the log output and adjust it here (0 % moisture).

    config SOIL_MOISTURE_WET_MV
        int "Sensor voltage when wet (mV)"
        range 0 3300
        default 1100
        help
            Sensor output voltage with the probe in a glass of water (up to the
            marking line). Read the value from the log output and adjust it here
            (100 % moisture).

    config SOIL_MOISTURE_SAMPLES
        int "Samples averaged per reading"
        range 1 256
        default 16

    config SOIL_MOISTURE_INTERVAL_MS
        int "Measurement interval (ms)"
        range 100 3600000
        default 2000

    config SOIL_MOISTURE_DRY_THRESHOLD_PERCENT
        int "Scream when moisture is at or below (%)"
        range 0 100
        default 30

    config SCREAM_COOLDOWN_S
        int "Minimum time between two screams (s)"
        range 1 86400
        default 60

endmenu

menu "Screaming Plant: Audio"

    config AUDIO_VOLUME_PERCENT
        int "Volume (%)"
        range 1 400
        default 100
        help
            100 plays the files unchanged (best quality). Set the loudness on the speaker box.
            Lower values reduce the level if the AUX input of the box distorts; values above
            100 amplify and clip the peaks.

endmenu
```
